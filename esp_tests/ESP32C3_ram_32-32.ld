MEMORY
{
 ITCRAM (rwx) :  ORIGIN = 0x40380000, LENGTH = 32k
 DTCRAM (xrw) :  ORIGIN = 0x3FC88000, LENGTH = 32k
}

REGION_ALIAS("RAM",  DTCRAM);
REGION_ALIAS("RAM2", DTCRAM);

REGION_ALIAS("TEXT", ITCRAM);

INCLUDE rv32i_default_noflash.ld

