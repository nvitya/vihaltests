MEMORY
{
  OCRAM (xrw) :   ORIGIN = 0x10003800, LENGTH = 2K
  OCROM (xrw) :   ORIGIN = 0x80000000, LENGTH = 4K
}

REGION_ALIAS("TEXT", OCROM);

REGION_ALIAS("RAM",  OCRAM);
REGION_ALIAS("ITCRAM", OCRAM);
REGION_ALIAS("DTCRAM", OCRAM);
REGION_ALIAS("RAM2", OCRAM);

INCLUDE rv32i_default_noflash.ld

